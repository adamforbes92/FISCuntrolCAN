#include "bootLogos.h"

#include <LittleFS.h>

static const char* customBootLogoPath = "/bootlogo.bin";
static const char* customRpmLogoPath  = "/rpmlogo.bin";
static uint8_t customBootLogo[bootLogoBufferSize] = {};
static uint8_t customRpmLogo[bootLogoBufferSize]  = {};
static bool customBootLogoLoaded = false;
static bool customRpmLogoLoaded  = false;

const unsigned char MK4Golf[] PROGMEM = {
  0x00, 0x00, 0x00, 0x00, 0x00, 0x00, 0x00, 0x00, 0x00, 0x00, 0x00, 0x00, 0x00, 0x00, 0x00, 0x00,
  0x00, 0x08, 0x00, 0x00, 0x00, 0x00, 0x00, 0x00, 0x00, 0x7f, 0x00, 0x00, 0x00, 0x00, 0x00, 0x00,
  0x00, 0xc0, 0xc0, 0x00, 0x03, 0x00, 0x00, 0x00, 0x00, 0x9e, 0x40, 0x00, 0x02, 0x80, 0x18, 0x00,
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  0x00, 0x00, 0x00, 0x00, 0x00, 0x00, 0x00, 0x00, 0x00, 0x00, 0x00, 0x00, 0x00, 0x00, 0x00, 0x00
};

const unsigned char logo[] PROGMEM = {
  0xff, 0xff, 0xc0, 0x7e, 0x00, 0x03, 0xff, 0xf0, 0xff, 0xff, 0xc0, 0x7e, 0x00, 0x03, 0xff, 0xf8,
  0xff, 0xff, 0xc0, 0x7e, 0x00, 0x03, 0xff, 0xfc, 0xff, 0xff, 0xc0, 0x7e, 0x00, 0x03, 0xff, 0xfc,
  0xff, 0xff, 0xc0, 0x7e, 0x00, 0x03, 0xff, 0xfc, 0xff, 0xff, 0xc0, 0x7e, 0x00, 0x03, 0xff, 0xfc,
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  0xfc, 0x00, 0x00, 0x07, 0xe0, 0x03, 0xff, 0xfc
};

const unsigned char finger[] PROGMEM = {
  0x00, 0x00, 0x00, 0x00, 0x00, 0x00, 0x00, 0x00, 0x00, 0x00, 0x00, 0x00, 0x00, 0x00, 0x00, 0x00,
  0x00, 0x00, 0x00, 0x00, 0x00, 0x00, 0x00, 0x00, 0x00, 0x00, 0x00, 0x00, 0x00, 0x00, 0x00, 0x00,
  0x00, 0x00, 0x00, 0x00, 0x00, 0x00, 0x00, 0x00, 0x00, 0x00, 0x00, 0x00, 0x00, 0x00, 0x00, 0x00,
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  0x00, 0x00, 0x00, 0x00, 0x00, 0x00, 0x00, 0x00, 0x00, 0x00, 0x00, 0x00, 0x00, 0x00, 0x00, 0x00
};

const unsigned char danger[] PROGMEM = {
  // Danger to Manifold - 128x64 Monochrome Bitmap
  0x00, 0x00, 0x00, 0x00, 0x00, 0x00, 0x00, 0x00, 0x00, 0x00, 0x00, 0x00, 0x00, 0x00, 0x00, 0x00,
  0x00, 0x00, 0x00, 0x00, 0x00, 0x00, 0x00, 0x00, 0x00, 0x00, 0x00, 0x00, 0x00, 0x00, 0x00, 0x00,
  0x00, 0x00, 0x00, 0x00, 0x00, 0x00, 0x00, 0x00, 0x00, 0x00, 0x00, 0x00, 0x00, 0x00, 0x00, 0x00,
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  0x00, 0x00, 0x00, 0x00, 0x00, 0x00, 0x00, 0x00, 0x00, 0x00, 0x00, 0x00, 0x00, 0x00, 0x00, 0x00
};

const uint8_t* getBootLogoBitmap(uint8_t bootScreenId) {
    switch (bootScreenId) {
        case 2:
            return MK4Golf;
        case 3:
            return logo;
        case 4:
            return finger;
    case 5:
      return customBootLogoLoaded ? customBootLogo : nullptr;
        default:
            return nullptr;
    }
}

bool loadCustomBootLogo() {
  File logoFile = LittleFS.open(customBootLogoPath, "r");
  if (!logoFile) {
    customBootLogoLoaded = false;
    return false;
  }

  if (logoFile.size() != (size_t)bootLogoBufferSize) {
    logoFile.close();
    customBootLogoLoaded = false;
    return false;
  }

  const bool ok = logoFile.read(customBootLogo, bootLogoBufferSize) == (int)bootLogoBufferSize;
  logoFile.close();
  customBootLogoLoaded = ok;
  return ok;
}

bool hasCustomBootLogo() {
  return customBootLogoLoaded;
}

bool saveCustomBootLogoFromBmp(const char* bmpPath) {
  File bmpFile = LittleFS.open(bmpPath, "r");
  if (!bmpFile) {
    return false;
  }

  if (bmpFile.size() != bootLogoBufferSize) {
    bmpFile.close();
    return false;
  }

  uint8_t convertedLogo[bootLogoBufferSize];
  const bool readOk = bmpFile.read(convertedLogo, bootLogoBufferSize) == (int)bootLogoBufferSize;
  bmpFile.close();

  if (!readOk) {
    return false;
  }

  File outFile = LittleFS.open(customBootLogoPath, "w");
  if (!outFile) {
    return false;
  }

  const bool written = outFile.write(convertedLogo, bootLogoBufferSize) == bootLogoBufferSize;
  outFile.close();

  if (!written) {
    return false;
  }

  memcpy(customBootLogo, convertedLogo, bootLogoBufferSize);
  customBootLogoLoaded = true;
  return true;
}

const uint8_t* getRpmLogoBitmap(uint8_t rpmLogoId) {
  switch (rpmLogoId) {
    case 2:
      // Custom uploaded shift-light image; fall back to the danger preset
      // if no valid custom image is stored.
      return customRpmLogoLoaded ? customRpmLogo : danger;
    case 1:
    default:
      // Built-in "danger" rev/shift indicator preset.
      return danger;
  }
}

bool loadCustomRpmLogo() {
  File logoFile = LittleFS.open(customRpmLogoPath, "r");
  if (!logoFile) {
    customRpmLogoLoaded = false;
    return false;
  }

  if (logoFile.size() != (size_t)bootLogoBufferSize) {
    logoFile.close();
    customRpmLogoLoaded = false;
    return false;
  }

  const bool ok = logoFile.read(customRpmLogo, bootLogoBufferSize) == (int)bootLogoBufferSize;
  logoFile.close();
  customRpmLogoLoaded = ok;
  return ok;
}

bool hasCustomRpmLogo() {
  return customRpmLogoLoaded;
}

bool saveCustomRpmLogoFromBmp(const char* bmpPath) {
  File bmpFile = LittleFS.open(bmpPath, "r");
  if (!bmpFile) {
    return false;
  }

  if (bmpFile.size() != bootLogoBufferSize) {
    bmpFile.close();
    return false;
  }

  uint8_t convertedLogo[bootLogoBufferSize];
  const bool readOk = bmpFile.read(convertedLogo, bootLogoBufferSize) == (int)bootLogoBufferSize;
  bmpFile.close();

  if (!readOk) {
    return false;
  }

  File outFile = LittleFS.open(customRpmLogoPath, "w");
  if (!outFile) {
    return false;
  }

  const bool written = outFile.write(convertedLogo, bootLogoBufferSize) == bootLogoBufferSize;
  outFile.close();

  if (!written) {
    return false;
  }

  memcpy(customRpmLogo, convertedLogo, bootLogoBufferSize);
  customRpmLogoLoaded = true;
  return true;
}
